// https://github.com/JeffDess/zmk-config/blob/5d12b29c4598c2e8b99e4e72208bd0cbeb28ca0b/config/constants.h
#include "zmk-helpers/helper.h"
#include <behaviors/num_word.dtsi>

// Keys
#define ___ &trans
#define XXX &none
#define HYPER LS(LA(LC(LEFT_GUI)))
#define ISO NON_US_BSLH
#define NewTab RG(T)
#define PrevTab RG(RS(LEFT_BRACKET))
#define NextTab RG(RS(RIGHT_BRACKET))
#define SwitchApp RG(TAB)
#define PrevDesk RC(LEFT)
#define NextDesk RC(RIGHT)
#define ShowDesk RC(UP)
#define CloseTab RG(W)
#define PrevPage RG(LEFT)
#define NextPage RG(RIGHT)
#define Fullscreen LG(LC(F))
#define WNewTab LC(T)
#define WPrevTab LC(LS(TAB))
#define WNextTab LC(TAB)
#define WSwitchApp LA(TAB)
#define WPrevDesk LG(LC(LEFT))
#define WNextDesk LG(LC(RIGHT))
#define WShowDesk LG(D)
#define WCloseTab LC(W)
#define WPrevPage LA(LEFT)
#define WNextPage LA(RIGHT)
#define WFullscreen F11
#define TmuxPrefix LC(B)
#define ZmxDetach LC(BACKSLASH)
#define PrevWorkspc RG(RA(Q))
#define NextWorkspc RG(RA(E))
#define EURO LS(LA(N2))
#define POUNDS LA(N3)
#define YEN LA(Y)
#define TM LA(N2)

// FTL actions. Power - applies LS() to the same weapon, drone and system keys.
#define FTL_SETTINGS           ESC
#define FTL_PAUSE              SPACE
#define FTL_CLOAK              C
#define FTL_HACK               N
#define FTL_MIND               M
#define FTL_BATTERY            B
#define FTL_JUMP               V
#define FTL_MO_AUTOFIRE        LALT
#define FTL_TOG_AUTOFIRE       LCTRL
#define FTL_CREW_HOME          TAB
#define FTL_SHIP_MENU          U
#define FTL_OPEN_DOORS         Z
#define FTL_CLOSE_DOORS        X
#define FTL_SEND_CREW          T
#define FTL_RECALL_CREW        R
#define FTL_WEAPON_1           N1
#define FTL_WEAPON_2           N2
#define FTL_WEAPON_3           N3
#define FTL_WEAPON_4           N4
#define FTL_DRONE_1            N5
#define FTL_DRONE_2            N6
#define FTL_DRONE_3            N7
#define FTL_POWER_SHIELDS      A
#define FTL_POWER_ENGINES      S
#define FTL_POWER_O2           F
#define FTL_POWER_MEDBAY       D
#define FTL_POWER_ARTILLERY    Y
#define FTL_POWER_TELEPORTER   G
#define FTL_POWER_HACK         L
#define FTL_POWER_MIND         K
#define FTL_POWER_CLOAK        H

// Layers
// Must match order in which they are defined
#define ENT 0
#define WIN_MODE 1
#define SYM 2
#define NUM 3
#define PAD 4
#define NAV 5
#define FUN 6
#define MOU 7
#define WIN_SYM 8
#define WIN_NUM 9
#define WIN_MOU 10
#define WIN_NAV 11
#define WIN_FUN 12
#define FTL 13
#define FTL_POWER 14
#define FTL_DEPOWER 15

// OS
// https://github.com/urob/zmk-helpers/tree/main?tab=readme-ov-file#unicode-characters-and-language-collection
#define WINDOWS 0
#define LINUX 1
#define MAC_OS 2

#undef COPY
#undef PASTE
#undef CUT
#undef UNDO
#undef REDO
// macOS defaults; Windows mode overrides these bindings in base.keymap.
#define COPY LG(C)
#define PASTE LG(V)
#define CUT LG(X)
#define UNDO LG(Z)
#define REDO LS(LG(Z))
#define LockScreen LC(LG(Q))
#define WCOPY LC(C)
#define WPASTE LC(V)
#define WCUT LC(X)
#define WUNDO LC(Z)
#define WREDO LC(Y)
#define WLockScreen LG(L)

/* Global defaults */
// See ../readme.md#troubleshooting
#define TAPPING_TERM_MS 200
#define QUICK_TAP_MS 175
#define PRIOR_IDLE_MS 75
#define SHIFT_PRIOR_IDLE_MS 0 // cross-hand shift rolls; other mods keep PRIOR_IDLE_MS

&sk {
  release-after-ms = <900>;
  quick-release;
};

&sl { // Allow sticky mods to chord across sticky layers.
  ignore-modifiers;
};

&lt {
  flavor = "balanced";
  tapping-term-ms = <TAPPING_TERM_MS>;
  quick-tap-ms = <QUICK_TAP_MS>;
};

// Choose on Q press; modifiers added after entering Mouse still work normally.
ZMK_MOD_MORPH(q_mouse,
    bindings = <&lt MOU Q>, <&kp Q>;
    mods = <(MOD_LCTL | MOD_LSFT | MOD_LALT | MOD_LGUI | MOD_RCTL | MOD_RSFT | MOD_RALT | MOD_RGUI)>;
    keep-mods = <(MOD_LCTL | MOD_LSFT | MOD_LALT | MOD_LGUI | MOD_RCTL | MOD_RSFT | MOD_RALT | MOD_RGUI)>;
)

ZMK_CAPS_WORD(caps_word,
    continue-list = <
      UNDERSCORE MINUS
      BACKSPACE
    >;
)

&num_word {
  continue-list = <BSPC DEL DOT COMMA PLUS MINUS STAR FSLH EQUAL COLON>;
};

/ {
    behaviors {
        // num_word tap
        nwt: nwt {
            compatible = "zmk,behavior-hold-tap";
            #binding-cells = <2>;
            flavor = "balanced";
            tapping-term-ms = <TAPPING_TERM_MS>;
            quick-tap-ms = <QUICK_TAP_MS>;
            require-prior-idle-ms = <PRIOR_IDLE_MS>;
            bindings = <&kp>, <&num_word>;
        };
        // caps_word tap
        cwt: cwt {
            compatible = "zmk,behavior-hold-tap";
            #binding-cells = <2>;
            flavor = "balanced";
            tapping-term-ms = <TAPPING_TERM_MS>;
            quick-tap-ms = <QUICK_TAP_MS>;
            require-prior-idle-ms = <PRIOR_IDLE_MS>;
            bindings = <&kp>, <&caps_word>;
        };
    };
    macros {
        // <3
        lt3: lt3 {
            compatible = "zmk,behavior-macro";
            #binding-cells = <0>;
            bindings
                = <&macro_tap &kp LESS_THAN &kp N3 >
                ;
        };
    };
};
/* Homerow mods */

#define KEYS_L LT0 LT1 LT2 LT3 LT4 LT5 LM0 LM1 LM2 LM3 LM4 LM5 LB0 LB1 LB2 LB3 LB4 LB5
#define KEYS_R RT0 RT1 RT2 RT3 RT4 LT5 RM0 RM1 RM2 RM3 RM4 RM5 RB0 RB1 RB2 RB3 RB4 RB5
#define THUMBS LH2 LH1 LH0 RH0 RH1 RH2 // Thumbs on 36+ keys.

#define MAKE_HRM(NAME, HOLD, TAP, TRIGGER_POS) \
  ZMK_HOLD_TAP(NAME, \
    bindings = <HOLD>, <TAP>; \
    flavor = "balanced"; \
    tapping-term-ms = <TAPPING_TERM_MS>; \
    quick-tap-ms = <QUICK_TAP_MS>; \
    require-prior-idle-ms = <PRIOR_IDLE_MS>; \
    hold-trigger-on-release; \
    hold-trigger-key-positions = <TRIGGER_POS>; \
  )

MAKE_HRM(hml, &kp, &kp, KEYS_R THUMBS) // Left-hand HRMs.
MAKE_HRM(hmr, &kp, &kp, KEYS_L THUMBS) // Right-hand HRMs.

#define MAKE_HRM_SHIFT(NAME, HOLD, TAP, TRIGGER_POS) \
  ZMK_HOLD_TAP(NAME, \
    bindings = <HOLD>, <TAP>; \
    flavor = "balanced"; \
    tapping-term-ms = <TAPPING_TERM_MS>; \
    quick-tap-ms = <QUICK_TAP_MS>; \
    require-prior-idle-ms = <SHIFT_PRIOR_IDLE_MS>; \
    hold-trigger-on-release; \
    hold-trigger-key-positions = <TRIGGER_POS>; \
  )

MAKE_HRM_SHIFT(hmls, &kp, &kp, KEYS_R THUMBS) // Left-hand shift HRMs.
MAKE_HRM_SHIFT(hmrs, &kp, &kp, KEYS_L THUMBS) // Right-hand shift HRMs.

/*                     KEY POSITIONS

  ╭─────────────────────────╮ ╭─────────────────────────╮
  │ LT5 LT4 LT3 LT2 LT1 LT0 │ │ RT0 RT1 RT2 RT3 RT4 RT5 │
  │ LM5 LM4 LM3 LM2 LM1 LM0 │ │ RM0 RM1 RM2 RM3 RM4 RM5 │
  │ LB5 LB4 LB3 LB2 LB1 LB0 │ │ RB0 RB1 RB2 RB3 RB4 RB5 │
  ╰───────╮     LH2 LH1 LH0 │ │ RH0 RH1 RH2 ╭───────────╯
          ╰─────────────────╯ ╰─────────────╯ */

ZMK_COMBO(enter, &kp ENTER, RM1 RM2 RM3, ALL, 50, 75)
